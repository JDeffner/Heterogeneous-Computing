## smart-home-jd-lean/firmware/main/Kconfig.projbuild
```kconfig
menu "Assisted-Living device configuration"

    config ALSH_WIFI_SSID
        string "Wi-Fi SSID"
        default "myssid"
        help
            SSID of the access point the device connects to.

    config ALSH_WIFI_PASSWORD
        string "Wi-Fi password"
        default "mypassword"
        help
            WPA2 password for the access point.

    config ALSH_MQTT_URI
        string "MQTT broker URI"
        default "mqtt://192.168.1.10:1883"
        help
            URI of the Mosquitto broker, e.g. mqtt://<hub-ip>:1883.

    choice ALSH_DEVICE_TYPE
        prompt "Device role"
        default ALSH_DEVICE_TYPE_DOOR
        help
            Which kind of sensor this firmware image acts as.

        config ALSH_DEVICE_TYPE_DOOR
            bool "Door / contact sensor"
        config ALSH_DEVICE_TYPE_MOTION
            bool "Motion sensor"
        config ALSH_DEVICE_TYPE_BED
            bool "Bed occupancy sensor"
        config ALSH_DEVICE_TYPE_STOVE
            bool "Stove guard"
        config ALSH_DEVICE_TYPE_SOS
            bool "SOS panic button"
    endchoice

endmenu
```

## smart-home-jd-lean/firmware/sdkconfig.defaults
```kconfig
# Reasonable defaults; override via `idf.py menuconfig`.
CONFIG_ESP_MAIN_TASK_STACK_SIZE=6144
CONFIG_FREERTOS_HZ=1000
CONFIG_ESP_TASK_WDT_INIT=n
CONFIG_MQTT_PROTOCOL_311=y
CONFIG_LWIP_SNTP_MAX_SERVERS=1
# Keep the default partition table (includes an "nvs" partition for identity).
```
